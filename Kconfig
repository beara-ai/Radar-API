## Kconfig
```kconfig
# Copyright (c) 2026 Beara.ai
# SPDX-License-Identifier: Apache-2.0

rsource "drivers/radar/Kconfig"
```

## drivers/radar/Kconfig
```kconfig
# Copyright (c) 2026 Beara.ai
# SPDX-License-Identifier: Apache-2.0

menuconfig RADAR_FMCW
	bool "Raw-frame FMCW radar drivers"
	select RTIO
	select RTIO_SYS_MEM_BLOCKS
	select RTIO_CONSUME_SEM
	help
	  Enable the raw-frame FMCW radar driver API
	  (zephyr/drivers/radar_fmcw.h). Drivers deliver complete raw ADC
	  frames through RTIO into the application's memory pool and
	  describe them with radar_fmcw_get_frame_config().

if RADAR_FMCW

config RADAR_FMCW_INIT_PRIORITY
	int "FMCW radar init priority"
	default 90
	help
	  FMCW radar device driver initialization priority. Must be after
	  the drivers for the buses and GPIOs the radar uses.

rsource "bgt60tr13c/Kconfig"

endif # RADAR_FMCW
```

## drivers/radar/bgt60tr13c/Kconfig
```kconfig
config BGT60TR13C
	bool "Infineon BGT60TR13C mmWave radar driver"
	default y
	depends on DT_HAS_INFINEON_BGT60TR13C_ENABLED
	depends on RADAR_FMCW
	select SPI_ASYNC
	select SPI
	select GPIO
	help
	  Thin driver: retrieves raw ADC frames from the BGT60TR13C over SPI
	  and delivers them through the generic FMCW radar API
	  (zephyr/drivers/radar_fmcw.h), which also reports the frame
	  configuration. Frames are the FIFO's data as read, packed 12-bit
	  samples with the receivers interleaved, so the driver neither
	  unpacks nor reorders them. Does no signal processing itself.

if BGT60TR13C

module = BGT60TR13C
module-str = bgt60tr13c
source "subsys/logging/Kconfig.template.log_config"

config BGT60TR13C_FIFO_CHUNK_SAMPLES
	int "Samples read per FIFO interrupt"
	default 1024
	range 2 8192
	help
	  Sets the sensor's FIFO compare-reference (CREF) threshold: the
	  number of samples buffered on-chip before it raises an interrupt.
	  Must be even (sensor requirement) and must fit within the physical
	  FIFO. Frames larger than this are drained across
	  multiple interrupts automatically. Each read goes straight into the
	  frame buffer, so a larger value means fewer interrupts and longer
	  SPI transfers, but no extra RAM.

# Each radar picks its register list (profile) with its devicetree
# register-profile property, and describes the frames it produces with the
# generic radar-fmcw.yaml properties; see dts/bindings/radar. The build
# fails if the two disagree. These options only add a custom profile.

config BGT60TR13C_PROFILE_CUSTOM
	bool "Custom register profile header"
	help
	  Compile in your own bgt60-configurator-cli output, named by
	  BGT60TR13C_PROFILE_CUSTOM_FILE, for radars whose devicetree node
	  sets register-profile = "custom". Set that node's frame properties
	  (start-freq-khz, samples-per-chirp, rx-mask and so on) to match it.

config BGT60TR13C_PROFILE_CUSTOM_FILE
	string "Custom register profile header"
	depends on BGT60TR13C_PROFILE_CUSTOM
	help
	  Header generated by bgt60-configurator-cli, e.g.
	  "my_profile.h", found on the include path: add its directory with
	  zephyr_include_directories() in the application's CMakeLists.txt.

endif # BGT60TR13C
```

## dts/bindings/radar/infineon,bgt60tr13c.yaml
```yaml
description: |
  Infineon BGT60TR13C 60 GHz FMCW radar sensor, SPI-attached.

  Describes the bus wiring and the board-level facts about how the sensor
  is fitted, and the frame profile the application runs it with: the
  generic frame properties from radar-fmcw.yaml, and the register list
  that programs the radar to produce them (register-profile). The build
  fails, naming the property, if the two disagree.

  The driver reports the antenna geometry and calibration below through
  radar_fmcw_get_device_info(), and the active profile through
  radar_fmcw_get_frame_config(), so processing code configures itself
  from the device.

compatible: "infineon,bgt60tr13c"

include: [spi-device.yaml, radar-fmcw.yaml]

properties:
  reset-gpios:
    type: phandle-array
    required: true
    description: RSTN pin (active low, per the BGT60TR13C datasheet)

  irq-gpios:
    type: phandle-array
    required: true
    description: |
      FIFO CREF interrupt pin. Rises when the FIFO fill level passes the
      threshold set by xensiv_bgt60trxx_set_fifo_limit().

  register-profile:
    type: string
    required: true
    enum:
      - "people-tracking"
      - "custom"
    description: |
      Register list that programs this radar, generated by Infineon's
      bgt60-configurator-cli. Its frames must match this node's frame
      properties, and the build fails, naming the property, if they don't.
      The generated header only says how many RX antennas it enables, so
      rx-mask is checked by count: make sure it also names the antennas the
      register list was generated with (rx_antennas in its config.json).
      The BGT60TR13C has one TX antenna, so tx-pattern is always <0x1>.

      - people-tracking: 58.0-59.2 GHz (0.125 m range bins), Rx1..Rx3,
        128 samples x 32 chirps, 100 us chirps, 10 Hz frames. Range to
        about 8 m, +/-12.8 m/s. Matching frame properties:
          start-freq-khz = <58000000>; stop-freq-khz = <59200000>;
          samples-per-chirp = <128>; chirps-per-frame = <32>;
          sample-rate-hz = <2000000>; chirp-period-ns = <100050>;
          frame-period-us = <100070>; rx-mask = <0x7>; tx-pattern = <0x1>;
      - custom: the header named by CONFIG_BGT60TR13C_PROFILE_CUSTOM_FILE.

  rx-positions-um:
    type: array
    default: [2500, 0, 0, 2500, 0, 0]
    description: |
      Phase-centre position of each physical RX antenna, Rx1, Rx2, Rx3 in
      that order, as <azimuth elevation> pairs in micrometres, viewed from
      the front of the sensor (azimuth positive to the right, elevation
      positive up) before any mounting rotation.

      The BGT60TR13C has its antennas in the package, so the default (the
      package's L-shaped lambda/2 layout: Rx1 beside Rx3, Rx2 above Rx3)
      is correct for every board using it and normally isn't overridden.
      The property exists so the description stays the same for radars
      whose antennas are on the PCB.

  rx-phase-offsets-mdeg:
    type: array
    default: [0, 0, 0]
    description: |
      Phase error of each physical RX antenna's receive path, Rx1, Rx2,
      Rx3 in that order, in millidegrees. Processing subtracts it from the
      channel's measured phase. Leave at zero for an uncalibrated board.
      Write negative values in parentheses, e.g. <0 (-1500) 2300>.

  rx-gain-offsets-mdb:
    type: array
    default: [0, 0, 0]
    description: |
      Gain error of each physical RX antenna's receive path, Rx1, Rx2, Rx3
      in that order, in millidecibels. Processing subtracts it from the
      channel's measured level. Leave at zero for an uncalibrated board.

  orientation:
    type: int
    default: 0
    enum: [0, 90, 180, 270]
    description: |
      Rotation of the sensor on the board in degrees, counter-clockwise as
      seen from the front. Applied to rx-positions-um before they are
      reported, so azimuth always means horizontal in the scene, e.g. a
      sensor mounted at 90 degrees measures azimuth across Rx2/Rx3
      instead of Rx1/Rx3.
```

## dts/bindings/radar/radar-fmcw.yaml
```yaml
# Copyright (c) 2026 Beara.ai
# SPDX-License-Identifier: Apache-2.0

description: |
  Frame profile common to every FMCW radar, included by each radar's own
  binding. It describes the frames the radar delivers, the same way for
  every vendor, and the driver reports them through
  radar_fmcw_get_frame_config().

  Every driver reads the profile with RADAR_FMCW_DT_PROFILE_DEFINE()
  (zephyr/drivers/radar_fmcw.h), which checks at build time that it
  describes frames the radar can produce. A driver that programs its radar
  from the profile derives its settings from it; one that programs a fixed
  configuration, such as a vendor register list, also checks that the
  configuration produces exactly these frames. Either way a mismatch fails
  the build, naming the radar and the property.

  Each radar node carries its own profile, so two radars in one build can
  run different profiles, e.g. on different frequency bands so they don't
  interfere. There are no defaults: the application chooses the profile,
  normally in its board overlay.

  Example:

    start-freq-khz = <58000000>;
    stop-freq-khz = <59200000>;
    samples-per-chirp = <128>;
    chirps-per-frame = <32>;
    sample-rate-hz = <2000000>;
    chirp-period-ns = <100050>;
    frame-period-us = <100070>;
    rx-mask = <0x7>;
    tx-pattern = <0x1>;

properties:
  start-freq-khz:
    type: int
    required: true
    description: |
      RF frequency at the first ADC sample of a chirp, in kHz. With
      stop-freq-khz this gives the sampled bandwidth, which sets the range
      resolution (c / 2B).

  stop-freq-khz:
    type: int
    required: true
    description: RF frequency at the last ADC sample of a chirp, in kHz.

  samples-per-chirp:
    type: int
    required: true
    description: ADC samples per chirp. Sets the range FFT length.

  chirps-per-frame:
    type: int
    required: true
    description: |
      Chirps per frame, counting every chirp of a TX pattern. Sets the
      Doppler FFT length.

  sample-rate-hz:
    type: int
    required: true
    description: ADC sample rate in Hz.

  chirp-period-ns:
    type: int
    required: true
    description: |
      Time from the start of one chirp to the start of the next, in ns.
      Sets the velocity resolution.

  frame-period-us:
    type: int
    required: true
    description: Time from the start of one frame to the start of the next, in us.

  rx-mask:
    type: int
    required: true
    description: |
      Bit mask of the physical RX antennas that receive, bit 0 being the
      first antenna in the radar's own antenna description. Frames hold one
      channel per enabled antenna, in ascending antenna order.

  tx-pattern:
    type: array
    required: true
    description: |
      Which physical TX antennas transmit on each chirp, as a pattern that
      repeats chirp after chirp. Each entry is a bit mask of the antennas
      that transmit together on one chirp, bit 0 being the first antenna in
      the radar's own antenna description; chirp c uses entry
      c % (number of entries).

      One entry for a radar that transmits the same way on every chirp,
      e.g. <0x1>. Time-division MIMO over three antennas, one at a time, is
      <0x1 0x2 0x4>. At most 8 entries (RADAR_FMCW_MAX_TX_PATTERN), and
      chirps-per-frame must be a whole number of repeats, so every frame
      starts at the first entry.
```
